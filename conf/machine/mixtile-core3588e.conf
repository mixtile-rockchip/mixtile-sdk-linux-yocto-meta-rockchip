## conf/machine/mixtile-core3588e.conf
```bitbake
# Copyright (c) 2021, Rockchip Electronics Co., Ltd
# Released under the MIT license (see COPYING.MIT for the terms)

#@TYPE: Machine
#@NAME: Mixtile Core3588E

require conf/machine/include/rk3588.inc

KBUILD_DEFCONFIG = "mixtile_core3588e_defconfig"
KERNEL_DEVICETREE = "rockchip/rk3588-mixtile-core3588e.dtb"

UBOOT_MACHINE = "rk3588_defconfig"
```
